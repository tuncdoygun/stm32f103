#include <stdio.h>
#include <stdint.h>
#include <string.h>

#include "system.h"
#include "io.h"
#include "uart.h"
#include "fifo.h"
#include "button.h"

#define SZ_BUF  256

#define LITTLE_ENDIAN

#define FREQ_TIMER      (SystemCoreClock)
#define MB_BAUD         9600
#define MB_DEVICE       1

#define SZ_ADU          256
#define SZ_PDU          253

#define MB_TIMEOUT      1000
#define MB_TIMER        TIMER_3
#define MB_TimerIRQ     TIM3_IRQHandler
#define MB_TIMER_ST     TIM3

volatile static uint8_t _mb_rsp_len, _mb_req_len;

static uint8_t _mb_req_adu[SZ_ADU];
volatile static uint8_t _mb_rsp_adu[SZ_ADU];

////////////////////////////////////////////////////////////////////////////////

#ifdef LITTLE_ENDIAN
void SwapUint16(void *buf)
{
  uint8_t temp;
  uint8_t *pVal = (uint8_t *)buf;
  
  temp = pVal[0];
  pVal[0] = pVal[1];
  pVal[1] = temp;
}
#endif

/* Table of CRC values for high–order byte */
static const uint8_t CRCtabHi[] = {
0x00, 0xC1, 0x81, 0x40, 0x01, 0xC0, 0x80, 0x41, 0x01, 0xC0, 0x80, 0x41, 0x00, 0xC1, 0x81,
0x40, 0x01, 0xC0, 0x80, 0x41, 0x00, 0xC1, 0x81, 0x40, 0x00, 0xC1, 0x81, 0x40, 0x01, 0xC0,
0x80, 0x41, 0x01, 0xC0, 0x80, 0x41, 0x00, 0xC1, 0x81, 0x40, 0x00, 0xC1, 0x81, 0x40, 0x01,
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0x00, 0xC1, 0x81, 0x40, 0x01, 0xC0, 0x80, 0x41, 0x01, 0xC0, 0x80, 0x41, 0x00, 0xC1, 0x81,
0x40
};

/* Table of CRC values for low–order byte */
static const uint8_t CRCtabLo[] = {
0x00, 0xC0, 0xC1, 0x01, 0xC3, 0x03, 0x02, 0xC2, 0xC6, 0x06, 0x07, 0xC7, 0x05, 0xC5, 0xC4,
0x04, 0xCC, 0x0C, 0x0D, 0xCD, 0x0F, 0xCF, 0xCE, 0x0E, 0x0A, 0xCA, 0xCB, 0x0B, 0xC9, 0x09,
0x08, 0xC8, 0xD8, 0x18, 0x19, 0xD9, 0x1B, 0xDB, 0xDA, 0x1A, 0x1E, 0xDE, 0xDF, 0x1F, 0xDD,
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0x44, 0x84, 0x85, 0x45, 0x87, 0x47, 0x46, 0x86, 0x82, 0x42, 0x43, 0x83, 0x41, 0x81, 0x80,
0x40
};

// MODBUS 16-bit CRC fonksiyonu
uint16_t CRC16(uint8_t *pMsg, uint8_t len)
{
  uint16_t crc = 0xFFFF;
  uint8_t crcHi = crc >> 8; 	/* high byte of CRC initialized */
  uint8_t crcLo = crc & 0xFF; /* low byte of CRC initialized */
  uint8_t idx ; /* will index into CRC lookup table */

  while (len--) 
  {
    idx = crcHi ^ *pMsg++ ; /* calculate the CRC */
    crcHi = crcLo ^ CRCtabHi[idx];
    crcLo = CRCtabLo[idx] ;
  }

  crc = ((uint16_t)crcHi << 8 | crcLo);
#ifdef LITTLE_ENDIAN
  SwapUint16(&crc);  
#endif  
  return crc;
}


////////////////////////////////////////////////////////////////////////////////

#define IUART_ST        USART1
#define IUART           UART_1
#define IUART_IRQn      USART1_IRQn

static unsigned char _RxBuf[SZ_BUF];
static unsigned char _TxBuf[SZ_BUF];

static FIFO     _RxFifo, _TxFifo;

void IUART_Init(void)
{
  // IUART baþlangýç
  UART_Init(IUART, 9600);
  
  // FIFO baþlangýç
  FIFO_Init(&_RxFifo, _RxBuf, SZ_BUF);
  FIFO_Init(&_TxFifo, _TxBuf, SZ_BUF);
  
  // Interrupt ayarlarý
  // a) ST yakasý
  USART_ITConfig(IUART_ST, USART_IT_RXNE, ENABLE);
  //USART_ITConfig(IUART_ST, USART_IT_TXE, ENABLE); // Kapalý olmalý,cunku acik olursa islemci acilir acilmaz kesmeye girer.
  
  // b) ARM takasý
  NVIC_SetPriority(IUART_IRQn, 3);
  NVIC_EnableIRQ(IUART_IRQn);
}

volatile static int _txFlag; // mevcut gonderme islemi var mi yok mu

void MB_TimerStart(void)
{
  Timer_Reset(MB_TIMER);
  Timer_Start(MB_TIMER, TRUE);
}

void MB_TimerStop(void)
{
  Timer_Start(MB_TIMER, FALSE);
}

void USART2_IRQHandler(void)
{
  unsigned char c;
  
  if (USART_GetITStatus(IUART_ST, USART_IT_RXNE)) {
    MB_TimerStop();
    // gelen veriyi alýyoruz
    c = USART_ReceiveData(IUART_ST);
    
    // FIFO buffer'a ekliyoruz
    FIFO_SetData(&_RxFifo, c);
    MB_TimerStart();
  }
  
  if (USART_GetITStatus(IUART_ST, USART_IT_TXE)) {
    // Tx FIFO'dan veri çekiyoruz
    c = FIFO_GetData(&_TxFifo);
    
    // Veriyi TDR'a yüklüyoruz
    USART_SendData(IUART_ST, c);
    
    // Gönderilecek veri kalmadýysa TX kesme kaynaðý kapatýlmalý
    if (FIFO_IsEmpty(&_TxFifo)) {
      USART_ITConfig(IUART_ST, USART_IT_TXE, DISABLE); 
      _txFlag = 0;
    }
  }  
}

void MB_TimerIRQ(void)
{
  if (TIM_GetITStatus(MB_TIMER_ST, TIM_IT_Update) == SET) {
    _mb_rsp_len = FIFO_GetCount(&_RxFifo);
      
    MB_TimerStop();
    TIM_ClearITPendingBit(MB_TIMER_ST, TIM_IT_Update);
  }
}

void IUART_SendData(void *buf, int len)
{
  const unsigned char *ptr = (const unsigned char *)buf;
  
  FIFO_Clear(&_TxFifo);
  
  // Önce Tx FIFO'ya göndereceðimiz veriyi yüklüyoruz
  while (!FIFO_IsFull(&_TxFifo) && (len-- > 0))
    FIFO_SetData(&_TxFifo, *ptr++);
  
  _txFlag = 1;
  // Gönderme kesmesini açýyoruz
  USART_ITConfig(IUART_ST, USART_IT_TXE, ENABLE); 
}

////////////////////////////////////////////////////////////////////////////////

void MB_Init(void)
{
  IUART_Init();
  
  Timer_Init(MB_TIMER, 39, FREQ_TIMER / MB_BAUD, 1);
  Timer_IntConfig(MB_TIMER, 4);
}

int MB_Request(uint8_t adr, uint8_t *mb_req_pdu, uint8_t mb_req_pdu_len)
{
  uint16_t crc;
  
  if (mb_req_pdu_len > SZ_PDU)
    return FALSE;
  
  // PDU'yu ADU zarfýna yerleþtiriyoruz
  _mb_req_adu[0] = adr;
  memcpy(_mb_req_adu + 1, mb_req_pdu, mb_req_pdu_len);
  
  crc = CRC16(_mb_req_adu, mb_req_pdu_len + 1);
  *(uint16_t *)(_mb_req_adu + mb_req_pdu_len + 1) = crc;
  
  _mb_req_len = mb_req_pdu_len + 3;
  IUART_SendData(_mb_req_adu, _mb_req_len);
  
  return TRUE;
}

////////////////////////////////////////////////////////////////////////////////

void MB_PrintPDU(uint8_t *pdu, uint8_t len)
{
  int i;
  
  for (i = 0; i < len; ++i)
    printf("%02X", pdu[i]);
  
  printf("\n");
}

// Geri dönüþ: 0 baþarýsýz
// Baþarýlý ise response PDU uzunluðu
int MB_Response(uint8_t *pmb_rsp_pdu)
{
  int i;
  uint16_t crc;
  
  if (_mb_rsp_len == 0)
    return 0;
  
  for (i = 0; i < _mb_rsp_len; ++i)
    _mb_rsp_adu[i] = FIFO_GetData(&_RxFifo);
  
  if (_mb_req_adu[0] != _mb_rsp_adu[0])
    return 0;
  
  if (_mb_req_adu[1] != (_mb_rsp_adu[1] & 0x7F))
    return 0;
  
  crc = CRC16((uint8_t *)_mb_rsp_adu, _mb_rsp_len);
  if (crc)
    return 0;

  memcpy(pmb_rsp_pdu, (void const *)(_mb_rsp_adu + 1), _mb_rsp_len - 3);
  return _mb_rsp_len - 3;
}

void Task_MB(void)
{
  static enum {
    S_INIT,
    S_WAIT_KEY,
    S_REQUEST,
    S_WAIT_RSP,
    S_RESPONSE,
  } state = S_INIT;
  
  static clock_t t0, t1;
  static uint8_t mb_req_pdu[SZ_PDU];
  static uint8_t mb_rsp_pdu[SZ_PDU];
  uint8_t mb_rsp_pdu_len;
  static unsigned long count;
  
  t1 = clock();

  switch (state) {
  case S_INIT:
    MB_Init();
    state = S_WAIT_KEY;
    break;
    
  case S_WAIT_KEY:
    if (g_Buttons[0]) {
      g_Buttons[0] = 0;
      
      state = S_REQUEST;
    }
    break;
    
  case S_REQUEST:
    _mb_rsp_len = 0;

    mb_req_pdu[0] = 0x03;   // Fonksiyon 3
                            // Read holding registers
    mb_req_pdu[1] = 0x00;
    mb_req_pdu[2] = 0x63;   // Addres: 0x0063 (99)
      // 40001 + adr = 40100

    mb_req_pdu[3] = 0x00;
    mb_req_pdu[4] = 0x0A;   // Length: 0x000A (10)
    
    OLED_SetCursor(1, 10);
    printf("%lu", ++count);
    OLED_SetCursor(2, 0);
    printf("(Q) ");
    MB_PrintPDU(mb_req_pdu, 5);
    
    if (MB_Request(MB_DEVICE, mb_req_pdu, 5)) {
      t0 = clock();
      state = S_WAIT_RSP;
    }
    break;
    
  case S_WAIT_RSP:
    if (_mb_rsp_len)
      state = S_RESPONSE;
    else if (t1 - t0 >= MB_TIMEOUT) {   
      OLED_SetCursor(3, 0);
      printf("(R) Timeout!");
      state = S_WAIT_KEY;
    }
    break;
    
  case S_RESPONSE:
    mb_rsp_pdu_len = MB_Response(mb_rsp_pdu);
    
    if (mb_rsp_pdu_len) {
      OLED_SetCursor(3, 0);
      printf("(R) ");
      MB_PrintPDU(mb_rsp_pdu, mb_rsp_pdu_len);
    }
    else {
      OLED_SetCursor(3, 0);
      printf("*ERROR**");
    }

    state = S_WAIT_KEY;
    break;
  }  
}

